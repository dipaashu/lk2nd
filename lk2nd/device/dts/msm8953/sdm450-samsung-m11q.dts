//SPDX-License-Identifier: GPL-2.0-only

/dts-v1/;

#include <skeleton64.dtsi>
#include <lk2nd.dtsi>
/ {
	// This is used by the bootloader to find the correct DTB
        qcom,msm-id = <0x152 0x00>;
	qcom,board-id = <0x0b 0xf6>;
};

&lk2nd {
	model = "Qualcomm Technologies, Inc. SDM450 + PMI632 SOC";
	compatible = "qcom,sdm450";
	
	lk2nd,dtb-files = "sdm450-samsung-m11q";
};
